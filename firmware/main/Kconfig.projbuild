## firmware/main/Kconfig.projbuild
```kconfig
menu "StickS3 Voice"
    config STICKS3_CLAUDE_KEY
        int "Claude hold key (USB HID usage, decimal)"
        range 4 115
        default 44
        help
            Default 44 is Space. The focused terminal must use a matching binding.
            Modifier combinations are not supported by this setting.

    config STICKS3_CODEX_KEY
        int "Codex voice toggle key (USB HID usage, decimal)"
        range 4 115
        default 65
        help
            Default 65 is F8. This is version-dependent; verify your CLI binding.

    config STICKS3_MAX_HOLD_SECONDS
        int "Maximum microphone hold (seconds)"
        range 10 90
        default 90

    config STICKS3_UI_TURKISH
        bool "Use Turkish display labels"
        default n
endmenu
```

## firmware/sdkconfig.defaults
```kconfig
CONFIG_IDF_TARGET="esp32s3"
CONFIG_ESPTOOLPY_FLASHSIZE_8MB=y
CONFIG_ESPTOOLPY_FLASHMODE_DIO=y
CONFIG_ESPTOOLPY_FLASHFREQ_80M=y
CONFIG_COMPILER_HIDE_PATHS_MACROS=y
CONFIG_SPIRAM=y
CONFIG_SPIRAM_MODE_OCT=y
CONFIG_SPIRAM_SPEED_80M=y
# CONFIG_ESP_CONSOLE_UART_DEFAULT is not set
CONFIG_ESP_CONSOLE_USB_SERIAL_JTAG=y
CONFIG_ESP_CONSOLE_SECONDARY_NONE=y
CONFIG_FREERTOS_HZ=1000
CONFIG_USB_DEVICE_UAC_AS_PART=y
CONFIG_UAC_SPEAKER_CHANNEL_NUM=0
CONFIG_UAC_MIC_CHANNEL_NUM=1
CONFIG_UAC_SAMPLE_RATE=48000
CONFIG_UAC_MIC_INTERVAL_MS=10
CONFIG_UAC_SUPPORT_MACOS=y
CONFIG_UAC_MIC_TASK_PRIORITY=6
CONFIG_UAC_MIC_TASK_CORE=1
CONFIG_UAC_TINYUSB_TASK_CORE=0
CONFIG_COMPILER_OPTIMIZATION_PERF=y
```
